/*
 Reflections, mobile connected entertainment device

 Repository is at https://github.com/frankcohen/ReflectionsOS
 Includes board wiring directions, server side components, examples, support

 Licensed under GPL v3 Open Source Software
 (c) Frank Cohen, All rights reserved. fcohen@starlingwatch.com
 Read the license in the license.txt file that comes with this code.
*/

#include "ShowTime.h"

extern LOGGER logger;
extern Arduino_GFX *gfx;
extern const char* root_ca;   // Defined in secrets.h

ShowTime::ShowTime(){}

String ShowTime::getRTCtime()
{
  struct tm timeinfo;
  if ( ! getLocalTime( &timeinfo ) ) 
  {
    return "0 o'clock";
  }

  int hour = timeinfo.tm_hour;
  int minute = timeinfo.tm_min;
  String period = "AM";

  if (hour >= 12) {
    period = "PM";
    if (hour > 12) {
      hour -= 12;
    }
  } else if (hour == 0) {
    hour = 12; // Midnight case
  }

  String minuteStr = (minute < 10) ? "0" + String(minute) : String(minute);
  String timeStr = String(hour) + ":" + minuteStr + " " + period;

  return timeStr;
}

// Low Battery indicator

const uint16_t BATTERY_TRANSPARENT_COLOR = 0xFFE0;

#define BATTERY_Y 210
#define BATTERY_X 103

#define BATTERYLOW_HEIGHT 32
#define BATTERYLOW_WIDTH 34

// Converter binary/image to C source, https://notisrac.github.io/FileToCArray/

const uint16_t BatteryIcon [] PROGMEM  = {
0xffe0, 0xffe0, 0xffe0, 0xffe0, 0xffe0, 0xffe0, 0xffe0, 0xffe0, 0xffe0, 0xffe0, 0xffe0, 0xffe0,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 0xffe0, 
  0xffe0, 0xffe0, 0xffe0, 0xffe0, 0xffe0, 0xffe0, 0xffe0, 0xffe0, 0xffe0, 0xffe0, 0xffe0, 0xffe0,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 0xffe0, 
  0xffe0, 0xffe0, 0xffe0, 0xffe0, 0xffe0, 0xffe0, 0xffe0, 0xffe0, 0xffe0, 0xffe0, 0xffe0, 0xffe0,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 0xffe0, 
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  0xffe0, 0xffe0, 0xffe0, 0xffe0, 0xffe0, 0xffe0, 0xffe0, 0xffe0, 0xffe0, 0xffe0, 0xffe0, 0xffe0,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 0xffe0
};

  // Clock fun messages
  
  const char* timetext[52][2] = {
  { "It's early", "to be exact" },
  { "It's late", "to be exact"},
  { "Wait, wait","you waited!"},
  { "Peekaboo","i see you"},
  { "Why?","why not?"},
  { "When?","and where?"},
  { "So little time","to be exact"},
  { "Will this end?","and when?"},
  { "Cats forever!","meow"},
  { "Hug please","forever"},
  { "I'm late","an important date"},
  {"We're all mad","here, you know."},
  {"Grin","like a cat."},
  {"Curiouser","and curiouser."},
  {"Imagination","is the only key."},
  {"Oh, you can't","help that."},
  {"How do you","like me now?"},
  {"I've often seen","a cat without"},
  {"Most everyone","is mad here"},
  {"A dream","within a dream"},
  {"I've gone","entirely mad"},
  {"We're all mad","here, indeed"},
  {"I've gone mad","how did that happen?"},
  {"Simply mad","as a hatter"},
  {"Twiddledee","and Twiddledum."},
  {"I vanish","like a ghost"},
  {"Very","mysterious"},
  {"Truly","a wonderland"},
  {"I appear","and disappear"},
  {"Do you play","croquet?"},
  {"Follow","the white rabbit"},
  {"Mind the gap","between us"},
  {"Lost my way","in the fog"},
  {"See me?","Or maybe not"},
  {"Dancing in","the moonlight"},
  {"I am mad","but so are you"},
  {"Find me","if you can"},
  {"A place","like no other"},
  {"Do you","believe?"},
  {"Laughing all","the way"},
  {"In the world","of dreams"},
  {"Catch me","if you can"},
  {"Playful as","a kitten"},
  {"Look closely","at nothing"},
  {"Smiling from","ear to ear"},
  {"Invisible","and yet here"},
  {"Wondering why","we exist"},
  {"In a land","of wonder"},
  {"Peculiar","and strange"},
  {"Chasing my","own tail"},
  {"Such a","curious place"}
  };

void drawBackgroundImage(const uint16_t *image, int16_t width, int16_t height) {
    
    gfx->draw16bitBeRGBBitmap( 0, 0, (uint16_t *) image, width, height );
}

/* Draws sprite, does not draw for transparent pixels */

void ShowTime::drawSpriteOverBackground(const uint16_t *sprite, int16_t spriteWidth, int16_t spriteHeight, int16_t x, int16_t y, uint16_t transparent) {
    for (int16_t i = 0; i < spriteHeight; i++) {
        for (int16_t j = 0; j < spriteWidth; j++) {
            uint16_t pixelColor = sprite[i * spriteWidth + j];
            if (pixelColor != transparent) {
                gfx->drawPixel(x + j, y + i, pixelColor);
            }
        }
    }
}

void ShowTime::begin()
{ 
  ShowTimeWaitTime = millis();
  activated = false;
  timeValid = false;
  theTime = "0 o'clock";
}

bool ShowTime::test()
{
  return true;
}

boolean ShowTime::fadeInCenteredText( String text, int16_t y, uint16_t duration, uint16_t color, const GFXfont * font)
{
  if ( fadeset )
  {
    fadeset = 0;
    gfx->setFont( font );
    gfx->getTextBounds( text.c_str(), 0, 0, &x, &y, &w, &h);    

    fadestep = 1;
    steps = 128; // One step per color intensity value
    stepDelay = ( duration / steps ) / 4; // Delay between steps in milliseconds

    return false;
  }
  else
  {
    fadestep++;

    if ( fadestep >= steps ) return true;

    uint16_t r = map( fadestep, 0, steps, (COLOR_BACKGROUND >> 11) & 0x1F, (color >> 11) & 0x1F);
    uint16_t g = map( fadestep, 0, steps, (COLOR_BACKGROUND >> 5) & 0x3F, (color >> 5) & 0x3F);
    uint16_t b = map( fadestep, 0, steps, COLOR_BACKGROUND & 0x1F, color & 0x1F);

    uint16_t textColor = (r << 11) | (g << 5) | b;

    gfx->setCursor( (gfx->width() - w) / 2, y );
    gfx->setTextColor( textColor );
    gfx->println( text );
  }

  return false;
}

boolean ShowTime::fadeOutCenteredText( String text, int16_t y, uint16_t duration, uint16_t color, const GFXfont * font)
{
  if ( fadeset )
  {
    fadeset = 0;

    gfx->setFont( font );
    gfx->getTextBounds( text.c_str(), 0, 0, &x, &y, &w, &h);    

    fadestep = 128;
    steps = 128;
    stepDelay = ( duration / steps ) / 4;
    
    return false;
  }
  else
  {
    fadestep--;

    if ( fadestep == 0 ) return true;

    uint16_t r = map( fadestep, 0, steps, (COLOR_BACKGROUND >> 11) & 0x1F, (color >> 11) & 0x1F);
    uint16_t g = map( fadestep, 0, steps, (COLOR_BACKGROUND >> 5) & 0x3F, (color >> 5) & 0x3F);
    uint16_t b = map( fadestep, 0, steps, COLOR_BACKGROUND & 0x1F, color & 0x1F);

    uint16_t textColor = (r << 11) | (g << 5) | b;

    gfx->setFont( font );
    gfx->setCursor( (gfx->width() - w) / 2, y );
    gfx->setTextColor( textColor );
    gfx->println( text );
  }
  return false;
}

void ShowTime::startShow( int shownum )
{
  showNum = shownum;
  showStep = 0;
  activated = true;

  ShowTimeWaitTime = millis();
  stepDelay = 100;
}

// Function to get the number of pairs
int ShowTime::getNumPairs() {
  return sizeof(BatteryIcon) / sizeof(BatteryIcon[0]);
}

void ShowTime::runShowTellTime()
{
  if ( showStep == 0 )
  {
    gfx->begin();
    gfx->invertDisplay(true);
    gfx->fillScreen( COLOR_BACKGROUND );
    showStep = 1;
    fadeset = 1;
    theTime = getRTCtime();

    int index = random(0, 52);
    theMsg1 = timetext[ index ][ 0 ];
    theMsg2 = timetext[ index ][ 1 ];

    // Draws low battery warning icon

    drawSpriteOverBackground( BatteryIcon, BATTERYLOW_WIDTH, BATTERYLOW_HEIGHT, BATTERY_X, BATTERY_Y, BATTERY_TRANSPARENT_COLOR );
    
    return;
  }

  if ( showStep == 1 )
  {
    if ( fadeInCenteredText( theMsg1, 100, 100, COLOR_TEXT_YELLOW, &Some_Time_Later20pt7b ) )
    {
      showStep = 2;
      fadeset = 1;
    }
    else
    {
      return;
    }
  }

  if ( showStep == 2 )
  {
    if ( fadeInCenteredText( theTime, 140, 50, COLOR_STRIPE_MEDIUM_GRAY, &Minya16pt7b ) )
    {
      showStep = 3;
      fadeset = 1;
    }
    else
    {
      return;
    }
  }

  if ( showStep == 3 )
  {
   if ( fadeInCenteredText( theMsg2, 180, 10, COLOR_STRIPE_PINK, &ScienceFair14pt7b ) )
    {
      showStep = 4;
      fadeset = 1;
    }
    else
    {
      return;
    }
  }

  if ( showStep == 4 )
  {
   if ( fadeOutCenteredText( theMsg2, 180, 10, COLOR_STRIPE_PINK, &ScienceFair14pt7b ) )
    {
      showStep = 5;
      fadeset = 1;
    }
    else
    {
      return;
    }
  }

  if ( showStep == 5 )
  {
    if ( fadeOutCenteredText( theTime, 140, 50, COLOR_STRIPE_MEDIUM_GRAY, &Minya16pt7b ) )
    {
      showStep = 6;
      fadeset = 1;
    }
    else
    {
      return;
    }
  }

  if ( showStep == 6 )
  {
    if ( fadeOutCenteredText( theMsg1, 100, 100, COLOR_TEXT_YELLOW, &Some_Time_Later20pt7b ) )
    {
      activated = 0;
      showStep = 0;
      fadeset = 1;
      ShowTimeWaitTime = millis();
    }
    else
    {
      return;
    }
  }

}

void ShowTime::loop()
{

    if ( ( millis() - ShowTimeWaitTime ) > stepDelay )
    {
      ShowTimeWaitTime = millis();

      if ( ! activated )
      {
        startShow( 0 );
        return;
      }

      // Show the time

      if ( showNum == 0 ) runShowTellTime();

    }
}
